## Kconfig
```kconfig
config ZMK_DRV2605L_LAB
    bool "Enable DRV2605L haptics lab"

if ZMK_DRV2605L_LAB

config ZMK_DRV2605L_LAB_STUDIO_RPC
    bool "Control the DRV2605L through Studio RPC"
    depends on ZMK_STUDIO

endif
```
